## CMakeLists.txt
```
cmake_minimum_required(VERSION 3.20.0)

find_package(Zephyr REQUIRED HINTS $ENV{ZEPHYR_BASE})
project(f411_task_lab_zephyr)

target_include_directories(app PRIVATE ${CMAKE_CURRENT_SOURCE_DIR}/src)
target_sources(app PRIVATE
  src/main.c
  src/ultrasonic.c
  src/dht.c
)
```

## prj.conf
```kconfig
CONFIG_GPIO=y
CONFIG_SERIAL=y
CONFIG_CONSOLE=y
CONFIG_UART_CONSOLE=y
CONFIG_PRINTK=y
CONFIG_SYS_CLOCK_TICKS_PER_SEC=1000
CONFIG_THREAD_NAME=y
CONFIG_MAIN_STACK_SIZE=2048
```

## boards/nucleo_f411re.overlay
```dts
/*
 * NUCLEO-F411RE sensor pins used by F411_TASK_LAB STEP05.
 *
 * TRIG : PA1 (push-pull output)
 * ECHO : PA0 (input, both-edge interrupt)
 * DHT  : PA4 (bi-directional, external pull-up required)
 */

/ {
	f411_sensors: f411_sensors {
		compatible = "f411,sensors";
		status = "okay";

		trigger-gpios = <&gpioa 1 GPIO_ACTIVE_HIGH>;
		echo-gpios = <&gpioa 0 GPIO_ACTIVE_HIGH>;
		dht-gpios = <&gpioa 4 GPIO_ACTIVE_HIGH>;
	};
};
```

## dts/bindings/f411,sensors.yaml
```yaml
# Copyright (c) 2026 F411_TASK_LAB
# SPDX-License-Identifier: Apache-2.0

title: F411_TASK_LAB sensor pins

description: |
  GPIO lines used by the HC-SR04 ultrasonic sensor and the DHT11/DHT22
  sensor on NUCLEO-F411RE.

compatible: "f411,sensors"

include: base.yaml

properties:
  trigger-gpios:
    type: phandle-array
    required: true
    description: HC-SR04 TRIG pin

  echo-gpios:
    type: phandle-array
    required: true
    description: HC-SR04 ECHO pin

  dht-gpios:
    type: phandle-array
    required: true
    description: DHT data pin
```

## src/main.c
```c
#include "dht.h"
#include "ultrasonic.h"

#include <errno.h>
#include <stdarg.h>
#include <stdio.h>
#include <string.h>

#include <zephyr/drivers/gpio.h>
#include <zephyr/kernel.h>
#include <zephyr/sys/printk.h>

#define LED0_NODE DT_ALIAS(led0)
static const struct gpio_dt_spec led = GPIO_DT_SPEC_GET(LED0_NODE, gpios);

#define LOG_QUEUE_LEN 8U
#define LOG_LINE_SIZE 96U

#define STACK_LED 512U
#define STACK_US 1024U
#define STACK_DHT 1024U
#define STACK_LOGGER 1024U

#define PRIO_DHT 2
#define PRIO_US 3
#define PRIO_LED 4
#define PRIO_LOGGER 5

#define LED_BLINK_PERIOD_MS 500U
#define US_TASK_PERIOD_MS 1U
#define DHT_TASK_PERIOD_MS 10U

typedef struct {
	char line[LOG_LINE_SIZE];
} LogMessage;

K_MSGQ_DEFINE(log_queue, sizeof(LogMessage), LOG_QUEUE_LEN, 4U);

K_THREAD_STACK_DEFINE(led_stack, STACK_LED);
K_THREAD_STACK_DEFINE(us_stack, STACK_US);
K_THREAD_STACK_DEFINE(dht_stack, STACK_DHT);
K_THREAD_STACK_DEFINE(logger_stack, STACK_LOGGER);

static struct k_thread led_thread;
static struct k_thread us_thread;
static struct k_thread dht_thread;
static struct k_thread logger_thread;

static void log_send(const char *fmt, ...)
{
	LogMessage msg;
	va_list args;

	va_start(args, fmt);
	vsnprintf(msg.line, sizeof(msg.line), fmt, args);
	va_end(args);

	(void)k_msgq_put(&log_queue, &msg, K_NO_WAIT);
}

static void led_entry(void *arg1, void *arg2, void *arg3)
{
	ARG_UNUSED(arg1);
	ARG_UNUSED(arg2);
	ARG_UNUSED(arg3);

	for (;;) {
		gpio_pin_toggle_dt(&led);
		k_sleep(K_MSEC(LED_BLINK_PERIOD_MS));
	}
}

static void us_entry(void *arg1, void *arg2, void *arg3)
{
	ARG_UNUSED(arg1);
	ARG_UNUSED(arg2);
	ARG_UNUSED(arg3);

	for (;;) {
		Ultrasonic_Result result;

		ultrasonic_task();
		if (ultrasonic_get_result(&result) != 0) {
			log_send("D,%u,%u,%u,%d,%u,%u\r\n",
				 result.timestamp_ms,
				 result.distance_ref_mm,
				 result.distance_mm,
				 result.delta_mm,
				 result.valid,
				 result.errors);
		}

		k_sleep(K_MSEC(US_TASK_PERIOD_MS));
	}
}

static void dht_entry(void *arg1, void *arg2, void *arg3)
{
	ARG_UNUSED(arg1);
	ARG_UNUSED(arg2);
	ARG_UNUSED(arg3);

	for (;;) {
		Dht_Result env;
		int speed_x10;

		dht_task();
		if (dht_get_result(&env) == 0) {
			k_sleep(K_MSEC(DHT_TASK_PERIOD_MS));
			continue;
		}

		speed_x10 = 0;
		if (env.valid != 0U) {
			speed_x10 = 3313 + (606 * (int)env.temperature_c_x10) / 1000;
			ultrasonic_set_sound_speed_x10((uint16_t)speed_x10);
		}

		log_send("E,%u,%d,%u,%u,%u,%d\r\n",
			 env.timestamp_ms,
			 env.temperature_c_x10,
			 env.humidity_rh_x10,
			 env.valid,
			 env.errors,
			 speed_x10);

		k_sleep(K_MSEC(DHT_TASK_PERIOD_MS));
	}
}

static void logger_entry(void *arg1, void *arg2, void *arg3)
{
	LogMessage msg;

	ARG_UNUSED(arg1);
	ARG_UNUSED(arg2);
	ARG_UNUSED(arg3);

	for (;;) {
		if (k_msgq_get(&log_queue, &msg, K_FOREVER) == 0) {
			printk("%s", msg.line);
		}
	}
}

int main(void)
{
	printk("=== F411_TASK_LAB Step 5: Zephyr ===\r\n");
	printk("Zephyr RTOS: 4 threads, GPIO DT, message queue logger\r\n");
	printk("HC-SR04: TRIG=PA1, ECHO=PA0, 5 Hz sample, 1 Hz median\r\n");
	printk("DHT11/DHT22: DATA=PA4, 0.5 Hz, sound speed compensation\r\n");

	if (ultrasonic_init() != 0) {
		printk("ERROR: ultrasonic init failed\r\n");
		return 0;
	}

	if (dht_init() != 0) {
		printk("ERROR: DHT init failed\r\n");
		return 0;
	}

	if (!gpio_is_ready_dt(&led)) {
		printk("ERROR: LED GPIO not ready\r\n");
		return 0;
	}

	if (gpio_pin_configure_dt(&led, GPIO_OUTPUT_INACTIVE) != 0) {
		printk("ERROR: LED GPIO config failed\r\n");
		return 0;
	}

	k_thread_create(&logger_thread, logger_stack, K_THREAD_STACK_SIZEOF(logger_stack),
			logger_entry, NULL, NULL, NULL, PRIO_LOGGER, 0, K_NO_WAIT);
	k_thread_create(&led_thread, led_stack, K_THREAD_STACK_SIZEOF(led_stack),
			led_entry, NULL, NULL, NULL, PRIO_LED, 0, K_NO_WAIT);
	k_thread_create(&us_thread, us_stack, K_THREAD_STACK_SIZEOF(us_stack),
			us_entry, NULL, NULL, NULL, PRIO_US, 0, K_NO_WAIT);
	k_thread_create(&dht_thread, dht_stack, K_THREAD_STACK_SIZEOF(dht_stack),
			dht_entry, NULL, NULL, NULL, PRIO_DHT, 0, K_NO_WAIT);

	k_thread_name_set(&logger_thread, "LOG");
	k_thread_name_set(&led_thread, "LED");
	k_thread_name_set(&us_thread, "US");
	k_thread_name_set(&dht_thread, "DHT");

	return 0;
}
```

## src/dht.c
```c
#include "dht.h"

#include <string.h>

#include <zephyr/drivers/gpio.h>
#include <zephyr/kernel.h>
#include <zephyr/sys/time_units.h>

#define SENSOR_NODE DT_NODELABEL(f411_sensors)

static const struct gpio_dt_spec dht = GPIO_DT_SPEC_GET(SENSOR_NODE, dht_gpios);

#define DHT_READ_PERIOD_MS 2000U
#define DHT_START_LOW_US 20000U
#define DHT_RELEASE_US 30U
#define DHT_RESPONSE_TIMEOUT_US 200U
#define DHT_BIT_TIMEOUT_US 100U
#define DHT_ONE_THRESHOLD_US 50U

static uint32_t s_last_read_ms;
static uint32_t s_errors;
static uint8_t s_has_result;

static Dht_Result s_result;

static uint32_t wait_for_level(int level, uint32_t timeout_us)
{
	uint32_t start = k_cycle_get_32();

	while (gpio_pin_get_dt(&dht) != level) {
		if (k_cyc_to_us_floor32(k_cycle_get_32() - start) > timeout_us) {
			return 0U;
		}
	}

	return k_cyc_to_us_floor32(k_cycle_get_32() - start);
}

static uint32_t measure_high_time(void)
{
	uint32_t start = k_cycle_get_32();

	while (gpio_pin_get_dt(&dht) == 1) {
		if (k_cyc_to_us_floor32(k_cycle_get_32() - start) > DHT_BIT_TIMEOUT_US) {
			break;
		}
	}

	return k_cyc_to_us_floor32(k_cycle_get_32() - start);
}

static int read_bytes(uint8_t *data)
{
	uint8_t i;

	memset(data, 0, 5);

	gpio_pin_configure_dt(&dht, GPIO_OUTPUT);
	gpio_pin_set_dt(&dht, 1);
	k_busy_wait(1000U);
	gpio_pin_set_dt(&dht, 0);
	k_busy_wait(DHT_START_LOW_US);
	gpio_pin_set_dt(&dht, 1);
	k_busy_wait(DHT_RELEASE_US);
	gpio_pin_configure_dt(&dht, GPIO_INPUT);

	if ((wait_for_level(0, DHT_RESPONSE_TIMEOUT_US) == 0U) ||
	    (wait_for_level(1, DHT_RESPONSE_TIMEOUT_US) == 0U)) {
		return -EIO;
	}

	for (i = 0U; i < 40U; i++) {
		uint32_t high_us;

		if (wait_for_level(1, DHT_BIT_TIMEOUT_US) == 0U) {
			return -EIO;
		}

		high_us = measure_high_time();
		if (high_us > DHT_ONE_THRESHOLD_US) {
			data[i / 8U] |= (uint8_t)(1U << (7U - (i % 8U)));
		}
	}

	if (((data[0] + data[1] + data[2] + data[3]) & 0xFFU) != data[4]) {
		return -EIO;
	}

	return 0;
}

static int decode(const uint8_t *data, uint16_t *humidity_x10, int16_t *temp_x10)
{
	uint16_t humidity = ((uint16_t)data[0] << 8) | data[1];
	int16_t raw_temp = (int16_t)(((uint16_t)data[2] << 8) | data[3]);

	if ((humidity <= 1000U) && (raw_temp >= -400) && (raw_temp <= 800)) {
		*humidity_x10 = humidity;
		*temp_x10 = raw_temp;
		return 0;
	}

	humidity = ((uint16_t)data[0] * 10U) + data[1];
	raw_temp = (int16_t)(((uint16_t)data[2] * 10U) + data[3]);
	if ((humidity <= 1000U) && (raw_temp >= 0) && (raw_temp <= 800)) {
		*humidity_x10 = humidity;
		*temp_x10 = raw_temp;
		return 0;
	}

	return -EINVAL;
}

int dht_init(void)
{
	if (!gpio_is_ready_dt(&dht)) {
		return -ENODEV;
	}

	s_last_read_ms = k_uptime_get_32();
	return gpio_pin_configure_dt(&dht, GPIO_INPUT);
}

void dht_task(void)
{
	uint32_t now = k_uptime_get_32();
	uint8_t data[5];
	uint16_t humidity;
	int16_t temp;

	if ((s_last_read_ms != 0U) && ((now - s_last_read_ms) < DHT_READ_PERIOD_MS)) {
		return;
	}
	s_last_read_ms = now;

	s_result.timestamp_ms = now;
	s_result.valid = 0U;

	if (read_bytes(data) != 0) {
		s_errors++;
		s_result.errors = s_errors;
		s_has_result = 1U;
		return;
	}

	if (decode(data, &humidity, &temp) != 0) {
		s_errors++;
		s_result.errors = s_errors;
		s_has_result = 1U;
		return;
	}

	s_result.humidity_rh_x10 = humidity;
	s_result.temperature_c_x10 = temp;
	s_result.valid = 1U;
	s_result.errors = s_errors;
	s_has_result = 1U;
}

int dht_get_result(Dht_Result *result)
{
	if ((result == NULL) || (s_has_result == 0U)) {
		return 0;
	}

	*result = s_result;
	s_has_result = 0U;
	return 1;
}
```

## src/dht.h
```c
#ifndef F411_DHT_H_
#define F411_DHT_H_

#include <stdint.h>

typedef struct {
	uint32_t timestamp_ms;
	uint32_t errors;
	int16_t temperature_c_x10;
	uint16_t humidity_rh_x10;
	uint8_t valid;
} Dht_Result;

int dht_init(void);
void dht_task(void);
int dht_get_result(Dht_Result *result);

#endif
```

## src/ultrasonic.c
```c
#include "ultrasonic.h"

#include <zephyr/drivers/gpio.h>
#include <zephyr/kernel.h>
#include <zephyr/sys/time_units.h>

#define SENSOR_NODE DT_NODELABEL(f411_sensors)

static const struct gpio_dt_spec trig = GPIO_DT_SPEC_GET(SENSOR_NODE, trigger_gpios);
static const struct gpio_dt_spec echo = GPIO_DT_SPEC_GET(SENSOR_NODE, echo_gpios);

static struct gpio_callback echo_cb;

#define US_SAMPLE_COUNT 5U
#define US_TRIGGER_PERIOD_MS 200U
#define US_PUBLISH_PERIOD_MS 1000U
#define US_ECHO_TIMEOUT_MS 35U
#define US_TRIG_PULSE_US 10U
#define US_MIN_WIDTH_US 150U
#define US_MAX_WIDTH_US 30000U
#define US_MIN_DISTANCE_MM 20U
#define US_MAX_DISTANCE_MM 4000U
#define US_REF_SOUND_X10 3430U

enum us_state {
	US_STATE_IDLE,
	US_STATE_WAIT_ECHO,
};

static enum us_state s_state;
static uint32_t s_last_trigger_ms;
static uint32_t s_last_publish_ms;
static uint32_t s_trigger_ms;
static volatile uint32_t s_echo_start_cycle;
static volatile uint32_t s_echo_width_us;
static volatile uint8_t s_echo_seen;
static volatile uint8_t s_echo_done;

static uint16_t s_samples_ref[US_SAMPLE_COUNT];
static uint16_t s_samples_corr[US_SAMPLE_COUNT];
static uint8_t s_sample_index;
static uint8_t s_sample_count;
static uint16_t s_sound_speed_x10 = US_REF_SOUND_X10;
static uint32_t s_errors;
static uint8_t s_has_result;

static Ultrasonic_Result s_result;

static void echo_isr(const struct device *dev, struct gpio_callback *cb, uint32_t pins)
{
	uint32_t now;
	int level;

	ARG_UNUSED(dev);
	ARG_UNUSED(cb);
	ARG_UNUSED(pins);

	level = gpio_pin_get_dt(&echo);
	if (level < 0) {
		return;
	}

	now = k_cycle_get_32();
	if (level != 0) {
		s_echo_start_cycle = now;
		s_echo_seen = 1U;
		return;
	}

	if (s_echo_seen != 0U) {
		s_echo_width_us = k_cyc_to_us_floor32(now - s_echo_start_cycle);
		s_echo_done = 1U;
		s_echo_seen = 0U;
	}
}

static void trigger_pulse(void)
{
	uint32_t start = k_cycle_get_32();

	gpio_pin_set_dt(&trig, 1);
	while (k_cyc_to_us_floor32(k_cycle_get_32() - start) < US_TRIG_PULSE_US) {
	}
	gpio_pin_set_dt(&trig, 0);
}

static uint16_t median_u16(uint16_t *values, uint8_t count)
{
	uint8_t i;
	uint8_t j;

	for (i = 1U; i < count; i++) {
		uint16_t key = values[i];

		j = i;
		while ((j > 0U) && (values[j - 1U] > key)) {
			values[j] = values[j - 1U];
			j--;
		}
		values[j] = key;
	}

	return values[count / 2U];
}

static void store_sample(uint32_t width_us)
{
	uint32_t ref = (width_us * US_REF_SOUND_X10) / 20000U;
	uint32_t corr = (width_us * s_sound_speed_x10) / 20000U;

	if ((corr < US_MIN_DISTANCE_MM) || (corr > US_MAX_DISTANCE_MM)) {
		s_errors++;
		return;
	}

	s_samples_ref[s_sample_index] = (uint16_t)ref;
	s_samples_corr[s_sample_index] = (uint16_t)corr;
	s_sample_index = (s_sample_index + 1U) % US_SAMPLE_COUNT;
	if (s_sample_count < US_SAMPLE_COUNT) {
		s_sample_count++;
	}
}

static void publish(uint32_t now)
{
	uint16_t ref[US_SAMPLE_COUNT];
	uint16_t corr[US_SAMPLE_COUNT];
	uint8_t i;

	if (s_sample_count == 0U) {
		s_result.timestamp_ms = now;
		s_result.distance_ref_mm = 0U;
		s_result.distance_mm = 0U;
		s_result.delta_mm = 0;
		s_result.valid = 0U;
		s_result.errors = s_errors;
		s_has_result = 1U;
		return;
	}

	for (i = 0U; i < s_sample_count; i++) {
		ref[i] = s_samples_ref[i];
		corr[i] = s_samples_corr[i];
	}

	s_result.timestamp_ms = now;
	s_result.distance_ref_mm = median_u16(ref, s_sample_count);
	s_result.distance_mm = median_u16(corr, s_sample_count);
	s_result.delta_mm = (int32_t)s_result.distance_mm - (int32_t)s_result.distance_ref_mm;
	s_result.valid = 1U;
	s_result.errors = s_errors;
	s_has_result = 1U;
}

int ultrasonic_init(void)
{
	int ret;

	if (!gpio_is_ready_dt(&trig) || !gpio_is_ready_dt(&echo)) {
		return -ENODEV;
	}

	ret = gpio_pin_configure_dt(&trig, GPIO_OUTPUT_INACTIVE);
	if (ret != 0) {
		return ret;
	}

	ret = gpio_pin_configure_dt(&echo, GPIO_INPUT);
	if (ret != 0) {
		return ret;
	}

	gpio_init_callback(&echo_cb, echo_isr, BIT(echo.pin));
	ret = gpio_add_callback(echo.port, &echo_cb);
	if (ret != 0) {
		return ret;
	}

	return gpio_pin_interrupt_configure_dt(&echo, GPIO_INT_EDGE_BOTH);
}

void ultrasonic_task(void)
{
	uint32_t now = k_uptime_get_32();

	if (s_state == US_STATE_IDLE) {
		if ((now - s_last_trigger_ms) >= US_TRIGGER_PERIOD_MS) {
			s_echo_done = 0U;
			s_echo_seen = 0U;
			s_echo_width_us = 0U;
			trigger_pulse();
			s_trigger_ms = now;
			s_last_trigger_ms = now;
			s_state = US_STATE_WAIT_ECHO;
		}
	} else {
		if (s_echo_done != 0U) {
			uint32_t width = s_echo_width_us;

			s_echo_done = 0U;
			s_state = US_STATE_IDLE;
			if ((width >= US_MIN_WIDTH_US) && (width <= US_MAX_WIDTH_US)) {
				store_sample(width);
			} else {
				s_errors++;
			}
		} else if ((now - s_trigger_ms) >= US_ECHO_TIMEOUT_MS) {
			s_errors++;
			s_echo_seen = 0U;
			s_state = US_STATE_IDLE;
		}
	}

	if ((now - s_last_publish_ms) >= US_PUBLISH_PERIOD_MS) {
		s_last_publish_ms = now;
		publish(now);
	}
}

int ultrasonic_get_result(Ultrasonic_Result *result)
{
	if ((result == NULL) || (s_has_result == 0U)) {
		return 0;
	}

	*result = s_result;
	s_has_result = 0U;
	return 1;
}

uint8_t ultrasonic_is_idle(void)
{
	return (s_state == US_STATE_IDLE) ? 1U : 0U;
}

void ultrasonic_set_sound_speed_x10(uint16_t speed_x10)
{
	if ((speed_x10 >= 2500U) && (speed_x10 <= 4000U)) {
		s_sound_speed_x10 = speed_x10;
	}
}
```

## src/ultrasonic.h
```c
#ifndef F411_ULTRASONIC_H_
#define F411_ULTRASONIC_H_

#include <stdint.h>

typedef struct {
	uint32_t timestamp_ms;
	uint32_t distance_ref_mm;
	uint32_t distance_mm;
	int32_t delta_mm;
	uint8_t valid;
	uint32_t errors;
} Ultrasonic_Result;

int ultrasonic_init(void);
void ultrasonic_task(void);
int ultrasonic_get_result(Ultrasonic_Result *result);
uint8_t ultrasonic_is_idle(void);
void ultrasonic_set_sound_speed_x10(uint16_t speed_x10);

#endif
```
